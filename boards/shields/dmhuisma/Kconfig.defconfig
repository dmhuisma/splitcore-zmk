## boards/shields/dmhuisma/Kconfig.defconfig
```kconfig
if SHIELD_SPLITCORE_RIGHT

# Name must be less than 16 characters long!
config ZMK_KEYBOARD_NAME
    default "Splitcore KB"

config ZMK_SPLIT_ROLE_CENTRAL
    default y

# Set this to the number of peripherals your dongle will have.
# For a unibody, this would be 1. If you have left and right halves, set it to 2, etc.
config ZMK_SPLIT_BLE_CENTRAL_PERIPHERALS
    default 1

# Set this to ZMK_SPLIT_BLE_CENTRAL_PERIPHERALS + your desired number of BT profiles (default is 5)
config BT_MAX_CONN
    default 6

# Set this to the same number as BT_MAX_CONN
config BT_MAX_PAIRED
    default 6

config ZMK_SPLIT_BLE_CENTRAL_BATTERY_LEVEL_PROXY
    default y

config ZMK_SPLIT_BLE_CENTRAL_BATTERY_LEVEL_FETCHING
    default y

endif

if SHIELD_SPLITCORE_LEFT || SHIELD_SPLITCORE_RIGHT

config ZMK_SPLIT
    default y

config SPI
    default y

# Enable experimental BLE settings
# this helps the trackpoint work better
config BT_CTLR_ADVANCED_FEATURES
    default y

config ZMK_BLE_EXPERIMENTAL_CONN
    default y

config ZMK_BATTERY_REPORTING
    default y

endif
```

## boards/shields/dmhuisma/Kconfig.shield
```kconfig
# No whitespace after the comma or in your part name!
config SHIELD_SPLITCORE_LEFT
    def_bool $(shields_list_contains,splitcore_left)

# No whitespace after the comma or in your part name!
config SHIELD_SPLITCORE_RIGHT
    def_bool $(shields_list_contains,splitcore_right)
```
